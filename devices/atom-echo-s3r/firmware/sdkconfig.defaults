## devices/atom-echo-s3r/firmware/sdkconfig.defaults
```kconfig
CONFIG_ESPTOOLPY_FLASHSIZE_8MB=y
CONFIG_UAC_SPEAKER_CHANNEL_NUM=1
CONFIG_UAC_MIC_CHANNEL_NUM=1
CONFIG_UAC_SAMPLE_RATE=48000
CONFIG_UAC_BIT_RESOLUTION_16=y
CONFIG_UAC_TUSB_VID=0x303A
CONFIG_UAC_TUSB_PID=0x8001
CONFIG_UAC_TUSB_MANUFACTURER="Dan Prototype"
CONFIG_UAC_TUSB_PRODUCT="Dan Atom Audio"
CONFIG_UAC_TUSB_SERIAL_NUM="DANATOM-B43A45BCC020"
CONFIG_ESP_CONSOLE_UART_DEFAULT=y
CONFIG_ESP_CONSOLE_USB_SERIAL_JTAG=n
CONFIG_FREERTOS_HZ=1000
CONFIG_ESP_MAIN_TASK_STACK_SIZE=8192
```
